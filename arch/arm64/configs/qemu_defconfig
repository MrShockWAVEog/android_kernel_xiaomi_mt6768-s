## arch/arm64/configs/qemu_defconfig
```kconfig
CONFIG_NO_HZ_IDLE=y
CONFIG_BLK_DEV_INITRD=y
CONFIG_PREEMPT=y
CONFIG_ZSMALLOC=y
# CONFIG_EFI is not set
CONFIG_DEVTMPFS=y
CONFIG_DEVTMPFS_MOUNT=y
CONFIG_ZRAM=y
# CONFIG_MTK_CAMERA_ISP is not set
# CONFIG_MTK_CCCI_DEVICES is not set
# CONFIG_MTK_AVB20_SUPPORT is not set
# CONFIG_MTK_M4U is not set
# CONFIG_MTK_SYSTRACKER_DISABLE is not set
# CONFIG_MTK_BOOT_REASON is not set
# CONFIG_MTK_SCHED_INTEROP is not set
# CONFIG_MTK_ARCHCOUNTER_TIMESYNC is not set
# CONFIG_CONSOLE_LOCK_DURATION_DETECT is not set
CONFIG_SERIAL_AMBA_PL011=y
CONFIG_SERIAL_AMBA_PL011_CONSOLE=y
# CONFIG_MTK_ADDITIONAL_BATTERY_TABLE is not set
# CONFIG_MTK_WATCHDOG is not set
# CONFIG_MTK_WD_KICKER is not set
CONFIG_RTC_CLASS=y
CONFIG_TMPFS=y
# CONFIG_NOMOUNT is not set
```
